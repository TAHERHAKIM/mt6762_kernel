## Documentation/devicetree/bindings/clock/mediatek,mt6762-sys-clock.yaml
```yaml
# SPDX-License-Identifier: (GPL-2.0 OR BSD-2-Clause)
%YAML 1.2
---
$id: http://devicetree.org/schemas/clock/mediatek,mt6762-sys-clock.yaml#
$schema: http://devicetree.org/meta-schemas/core.yaml#

title: MediaTek System Clock Controller for MT6762

maintainers:
  - Brandon Boese <brandonboese@protonmail.com>

description:
  The apmixedsys module provides most of PLLs which generated from SoC 26m.
  The topckgen provides dividers and muxes which provides the clock source to other IP blocks.
  The infracfg_ao provides clock gate in peripheral and infrastructure IP blocks.

properties:
  compatible:
    items:
      - enum:
          - mediatek,mt6762-apmixedsys
          - mediatek,mt6762-topckgen
          - mediatek,mt6762-infracfg_ao
      - const: syscon

  reg:
    maxItems: 1

  '#clock-cells':
    const: 1

required:
  - compatible
  - reg
  - '#clock-cells'

additionalProperties: false

examples:
  - |
    topckgen: clock-controller@10000000 {
        compatible = "mediatek,mt6762-topckgen";
        reg = <0 0x10000000 0 0x1000>;
        #clock-cells = <1>;
    };
```
